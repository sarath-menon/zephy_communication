## Kconfig
```kconfig
mainmenu "MYAPP"

source "Kconfig.zephyr"
config MYAPP_STM32
  default y
  bool
  select USE_STM32_HAL_FOO
  select USE_STM32_LL_BAR
  select HAS_STM32CUBE
  select USE_STM32_HAL_UART
  select USE_STM32_HAL_GPIO
  select USE_STM32_HAL_PWR
  select USE_STM32_HAL_PWR_EX
  select USE_STM32_HAL_CORTEX

  
  
```
